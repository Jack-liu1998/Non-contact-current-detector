#include "stm32f10x.h"
#include "sys.h" 
#include "delay.h"
#include "fft.h"
#include "math.h"
#include "stdio.h"
#include "stm32_dsp.h"
#include "fft3.h"


uint32_t input[1024], output[1024], Mag[1024], Phase[1024]; /* 输入，输出和幅值 */
/*
*********************************************************************************************************
* 函 数 名: PowerMag
* 功能说明: 求模值
* 形 参：_usFFTPoints FFT点数
* 返 回 值: 无
*********************************************************************************************************
*/
void PowerMag(uint16_t _usFFTPoints)
{
    int16_t lX,lY;
    uint16_t i;
//float32_t mag;
    float mag;
    /* 计算幅值 */
    for (i=0; i< _usFFTPoints; i++)
    {
        lX= (output[i]<<16)>>16; /* 实部*/
        lY=(output[i]>> 16); /* 虚部 */
        mag =sqrtf(lX*lX+lY*lY); /* 求模 */
        Mag[i]=mag*2; /* 求模后乘以2才是实际模值，直流分量不需要乘2 */
    }

    /* 由于上面多乘了2，所以这里直流分量要除以2 */
    Mag[0]=Mag[0]>>1;
}

/*
*********************************************************************************************************
* 函 数 名: DSP_FFT1024
* 功能说明: 1024点FFT实现
* 形 参：无
* 返 回 值: 无
*********************************************************************************************************
*/
void DSP_FFT1024(void)
{
    uint16_t i;

    /* 获得1024个采样点 */
    for (i = 0; i< 1024; i++)
    {
        input[i] =0;
        /* 波形是由直流分量，50Hz正弦波和20Hz正弦波组成，波形采样率1KHz */
        input[i] =1024 + 1024*sin(2*3.1415926f*50*i/1000) + 512*sin(2*3.1415926f*20*i/1000) ;
    }

    /* 计算1024点FFT
    output：输出结果，高16位是虚部，低16位是实部。
    input ：输入数据，高16位是虚部，低16位是实部。
    第三个参数必须是1024。
    */
    cr4_fft_1024_stm32(output,input, 1024);

    /* 求幅值 */
    PowerMag(1024);

    /* 打印输出结果 */
    for (i = 0; i< 1024; i++)
    {
        printf("%d\r\n",Mag[i]);
    }
}

/*
*********************************************************************************************************
* 函 数 名: DSP_FFT64
* 功能说明: 64点FFT实现
* 形 参：无
* 返 回 值: 无
*********************************************************************************************************
*/
void DSP_FFT64(void)
{
    uint16_t i;

    /* 获得64个采样点 */
    for (i = 0; i< 64; i++)
    {
        input[i] = 0;
        /* 波形是由直流分量，5Hz正弦波和10Hz正弦波组成，波形采样率60Hz */
        input[i] =1024 + 1024*sin(2*3.1415926f*5*i/60) + 512*sin(2*3.1415926f*10*i/60) ;
    }

    /* 计算64点FFT
    output：输出结果，高16位是虚部，低16位是实部。
    input ：输入数据，高16位是虚部，低16位是实部。
    第三个参数必须是1024。
    */
    cr4_fft_64_stm32(output,input, 64);

    /* 求幅值 */
    PowerMag(64);

    /* 打印输出结果 */
    for (i = 0; i< 64; i++)
    {
        printf("%d\r\n",Mag[i]);
    }
}


/*
*********************************************************************************************************
* 函 数 名: DSP_FFT256
* 功能说明: 256点FFT实现
* 形 参：无
* 返 回 值: 无
*********************************************************************************************************
*/
void DSP_FFT256(void)
{
    uint16_t i;

    /* 获得256个采样点 */
    for (i = 0; i< 256; i++)
    {
        input[i] =0;
        /* 波形是由直流分量，50Hz正弦波和20Hz正弦波组成，波形采样率200Hz */
        input[i] =1024 + 1024*sin(2*3.1415926f*50*i/200) + 512*sin(2*3.1415926f*20*i/200) ;
    }

    /* 计算256点FFT
    output：输出结果，高16位是虚部，低16位是实部。
    input ：输入数据，高16位是虚部，低16位是实部。
    第三个参数必须是1024。
    */
    cr4_fft_256_stm32(output,input, 256);

    /* 求幅值 */
    PowerMag(256);

    /* 打印输出结果 */
    for (i = 0; i< 256; i++)
    {
        printf("%d\r\n",Mag[i]);
    }
}

/*
*********************************************************************************************************
* 函 数 名: Power_Phase_Radians
* 功能说明: 求相位
* 形 参：_usFFTPoints FFT点数
* 返 回 值: 无
*********************************************************************************************************
*/
void Power_Phase_Radians(uint16_t _usFFTPoints)
{
    int16_t lX, lY;
    uint16_t i;
    float phase;


    for (i=0; i<_usFFTPoints; i++)
    {
        lX=(output[i]<<16)>>16; /* 实部 */
        lY=(output[i] >> 16); /* 虚部 */

        phase = atan2(lY, lX); /* atan2求解的结果范围是(-pi, pi], 弧度制 */

        Phase[i] =phase* 180.0f/3.1415926f; /* 将求解的结果由弧度转换为角度 */
    }
}

/*
*********************************************************************************************************
* 函 数 名: DSP_FFTPhase
* 功能说明: 1024点FFT的相位求解
* 形 参：无
* 返 回 值: 无
*********************************************************************************************************
*/
void DSP_FFTPhase(void)
{
    uint16_t i;

    /* 获得1024个采样点 */
    for (i = 0; i< 1024; i++)
    {
        input[i] =0;

        /* 波形是由直流分量，50Hz正弦波组成，波形采样率1KHz */
        input[i] =1024 + 1024*sin(2*3.1415926f*50*i/1000 + 3.1415926f/3);
    }

    /* 计算1024点FFT
    output：输出结果，高16位是虚部，低16位是实部。
    input ：输入数据，高16位是虚部，低16位是实部。
    第三个参数必须是1024。
    */
    cr4_fft_1024_stm32(output,input, 1024);

    /* 求相频 */
    Power_Phase_Radians(1024);

    /* 打印输出结果 */
    for (i = 0; i< 1024; i++)
    {
        printf("%f\r\n",(float) Phase[i]);
    }
}

/////////////////////////////////////////////////////////////////////////////////////////